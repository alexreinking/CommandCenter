/*
 * Copyright (C) 2012 Texas Instruments Incorporated - http://www.ti.com/
 *
 * This program is free software; you can redistribute it and/or modify
 * it under the terms of the GNU General Public License version 2 as
 * published by the Free Software Foundation.
 */
/dts-v1/;
/plugin/;

/ {
    compatible = "ti,beaglebone", "ti,beaglebone-black";

    /* identification */
    part-number = "uart6pinmux";

    /* /dev/ttyO5 */
    fragment@0 {
        target = <&am33xx_pinmux>;
        __overlay__ {
            uart6pinmux: uart6pinmux_pins {
                pinctrl-single,pins = <
                    0x0C4 0x24  /* UART5_RXD muxRegOffset, INPUT | MODE4 */
                    0x0C0 0x04  /* UART5_TXD muxRegOffset, OUTPUT | MODE4 */
                >;
            };
        };
    };

    fragment@1 {
        target = <&uart6>;
        __overlay__ {
            status= "okay";
            pinctrl-names = "default";
            pinctrl-0 = <&uart6pinmux>;
            
        };
    };
};
